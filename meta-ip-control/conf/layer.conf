## meta-ip-control/conf/layer.conf
```bitbake
# We have a conf and classes directory, add to BBPATH
BBPATH .= ":${LAYERDIR}"

# We have recipes-* directories, add to BBFILES
BBFILES += "${LAYERDIR}/recipes-*/*/*.bb ${LAYERDIR}/recipes-*/*/*.bbappend"

BBFILE_COLLECTIONS += "ecrin-ipe"
BBFILE_PATTERN_ecrin-ipe := "^${LAYERDIR}/"
BBFILE_PRIORITY_ecrin-ipe = "4"
```

## meta-ip-control/conf/machine/ipcontrol-common.inc
```bitbake
#@TYPE: Machine
#@NAME: i.MX6Solo Varisicte MX6 SOM
#@DESCRIPTION: Machine configuration for Variscoite MX6Q SOM
#Varisicte VAR SOM MX6 common definitions for all Som's
#
#
include conf/machine/include/imx-ipcontrol-base.inc
include conf/machine/include/tune-cortexa9.inc

#
#variscite U-Boot
#
PREFERRED_PROVIDER_u-boot = "u-boot-variscite"
#
PREFERRED_PROVIDER_virtual/kernel = "linux-variscite"


#
#Set file system for 4GB not 1.
# This create the size of the SD-Card rootfs file system
IMAGE_ROOTFS_SIZE = "3600000"
#
SERIAL_CONSOLE = "115200 ttymxc0"

#Wifi/Bluetooth firmwre
MACHINE_EXTRA_RRECOMMENDS += "linux-firmware-wl12xx"

MACHINE_FEATURES += " pci wifi bluetooth"

#
# UBIFS for Variscite NAND 0.5 GB
#
IMAGE_FSTYPES += " ubi "
UBI_ROOT_FS_NAME = "[rootfs]"
UBI_VOLNAME  = "rootfs"
#MKUBIFS_ARGS = " -m 2048 -e 126976 -c 3950 "
MKUBIFS_ARGS = " -m 2048 -e 124KiB -c 3965 "
UBINIZE_ARGS = " -m 2048 -p 128KiB -s 2048 -O 2048 "

PREFERRED_PROVIDER_jpeg = "jpeg"
PREFERRED_PROVIDER_java2-runtime = "openjdk-7-jre"
PREFERRED_PROVIDER_java2-vm = "openjdk-7-jre"
PREFERRED_PROVIDER_jpeg-native = "jpeg-native"

PREFERRED_PROVIDER_virtual/java-initial = "cacao-initial"
PREFERRED_PROVIDER_virtual/java-native = "jamvm-native"
PREFERRED_PROVIDER_virtual/javac-native = "ecj-bootstrap-native"


PREFERRED_VERSION_openjdk-7-jre = "25b30-2.3.12"
PREFERRED_VERSION_icedtea7-native = "2.1.3"
```

## meta-ip-control/conf/machine/ipcontrol.conf
```bitbake
#@TYPE: Machine
#@NAME: i.MX6Q Varisicte MX6 Solo SOM
#@DESCRIPTION: Machine configuration for Variscoite MX6Q SOM
#Varisicte VAR SOM MX6 Solo U-Boot
#================================== 
#  mx6q_var_som_config             # VAR-SOM-MXQ/D,  boot from MMC
#  mx6q_var_som_nand_config        # VAR-SOM-MXQ/D,  boot from NAND
#  mx6dl_var_som_config            # VAR-SOM-MXDL,   boot from MMC
#  mx6dl_var_som_nand_config       # VAR-SOM-MXDL,   boot from NAND
#  mx6solo_var_som_config          # VAR-SOM-MXSolo, boot from MMC
#  mx6solo_var_som_nand_config     # VAR-SOM-MXSolo, boot from NAND

#
include conf/machine/ipcontrol-common.inc
#

UBOOT_MACHINE = "mx6solo_var_som_nand_config"
SOC_FAMILY = "mx6:mx6s"
```

## meta-yocto/conf/bblayers.conf.sample
```bitbake
# LAYER_CONF_VERSION is increased each time build/conf/bblayers.conf
# changes incompatibly
LCONF_VERSION = "6"

BBPATH = "${TOPDIR}"
BBFILES ?= ""

BBLAYERS ?= " \
  ##OEROOT##/meta \
  ##OEROOT##/meta-yocto \
  ##OEROOT##/meta-yocto-bsp \
  ##OEROOT##/meta-fsl-arm \
  ##OEROOT##/meta-fsl-arm-extra \
  ##OEROOT##/meta-ip-control \
  ##OEROOT##/meta-openembedded/meta-oe \
  ##OEROOT##/meta-openembedded/meta-webserver \
  ##OEROOT##/meta-openembedded/meta-initramfs \
  ##OEROOT##/meta-openembedded/meta-networking \
  "
BBLAYERS_NON_REMOVABLE ?= " \
  ##OEROOT##/meta \
  ##OEROOT##/meta-yocto \
  "
```
